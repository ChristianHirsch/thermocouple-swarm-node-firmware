## CMakeLists.txt
```
cmake_minimum_required(VERSION 3.8.2)

set(BOARD_ROOT ${CMAKE_CURRENT_LIST_DIR})
set(BOARD simblee_thermocouple_board)

include($ENV{ZEPHYR_BASE}/cmake/app/boilerplate.cmake NO_POLICY_SCOPE)
project(cooker-node)

target_sources(app PRIVATE
  src/main.c
  #src/cts.c
  src/ess.c
  src/bas.c
  src/battery.c
)
```

## prj.conf
```kconfig
# POWER SAVING
CONFIG_DEBUG=n
#CONFIG_SERIAL=n
#CONFIG_UART_NRFX=n
#CONFIG_SPEED_OPTIMIZATIONS=y
#CONFIG_BT_DEBUG_LOG=n


CONFIG_LOG=y
CONFIG_LOG_BACKEND_UART=y
CONFIG_LOG_DEFAULT_LEVEL=4
CONFIG_LOG_MAX_LEVEL=4

#CONFIG_LOG=n
#CONFIG_LOG_BACKEND_UART=n

#CONFIG_CONSOLE=n
#CONFIG_UART_CONSOLE=n

CONFIG_SPI=y
CONFIG_SENSOR=y
CONFIG_MAX31855=y

# GENERAL
CONFIG_REBOOT=y

# DEVICES
CONFIG_ADC=y
CONFIG_GPIO=y
CONFIG_PWM=y

# BLUETOOTH
CONFIG_BT=y
CONFIG_BT_PERIPHERAL=y
CONFIG_BT_DEVICE_NAME="thermocouple-swarm-node"
#CONFIG_BT_CTLR_TX_PWR_PLUS_4=y

# POWER MANAGEMENT
CONFIG_SYS_POWER_MANAGEMENT=y
CONFIG_DEVICE_POWER_MANAGEMENT=y
```

## src/main.c
```c
/*
 *
 */

#include <zephyr.h>
#include <zephyr/types.h>
#include <misc/byteorder.h>
#include <logging/log.h>
#include <settings/settings.h>
#include <device.h>
#include <gpio.h>
#include <soc.h>

#include <stddef.h>
#include <string.h>
#include <errno.h>

#include <bluetooth/bluetooth.h>
#include <bluetooth/conn.h>

#include "config.h"

#include "battery.h"

#ifndef IBEACON_RSSI
#define IBEACON_RSSI 0xc8
#endif

#define SENSE_INTERVAL 5
#define MEASUREMENTS_SIZE  10

/* in microseconds */
#define MIN_PERIOD	(USEC_PER_SEC / 64U)

/* in microseconds */
#define MAX_PERIOD	USEC_PER_SEC

// BT_GAP_ADV_SLOW_INT_MIN = 0x0640 ^= 1s
// BT_GAP_ADV_SLOW_INT_MAX = 0x0780 ^= 1.2s
#define BT_LE_ADV_CONN_NAME_ID BT_LE_ADV_PARAM(BT_LE_ADV_OPT_CONNECTABLE | \
                         BT_LE_ADV_OPT_USE_NAME | BT_LE_ADV_OPT_USE_IDENTITY, \
                         BT_GAP_ADV_SLOW_INT_MIN, \
                         BT_GAP_ADV_SLOW_INT_MAX)

LOG_MODULE_REGISTER(main);

static const struct bt_data ad[] = {
		BT_DATA_BYTES(BT_DATA_FLAGS, BT_LE_AD_NO_BREDR),
		BT_DATA_BYTES(BT_DATA_UUID16_ALL, 0xaa, 0xfe),
		BT_DATA_BYTES(BT_DATA_SVC_DATA16,
				0xaa, 0xfe,		/* Eddystone UUID */
				0x10,			/* Eddystone-URL frame type */
				0x04,			/* Calibrated Tx power at 0m */
				0x02,			/* URL Scheme Prefix http:// */
				'b','r','e','w','c','e','.',
				'c','h','r','i','v','i','e','h',
				0x03)
};

static void connected(struct bt_conn *conn, u8_t err)
{
	if (err) {
		LOG_ERR("Connection failed (err %u)\n", err);
		return;
	}

	bt_le_adv_stop();
}

static void disconnected(struct bt_conn *conn, u8_t reason)
{
	LOG_INF("Disconnected (reason %u)\n", reason);

	int err = bt_le_adv_start(BT_LE_ADV_CONN_NAME_ID, ad, ARRAY_SIZE(ad), NULL, 0);
	if (err) {
		LOG_ERR("Advertising failed to start (err %d)", err);
		return;
	}
    LOG_INF("Advertising successfully started");
}

static struct bt_conn_cb conn_callbacks = {
	.connected = connected,
	.disconnected = disconnected,
};

static void bt_ready(int err)
{
	if (err) {
		LOG_ERR("Failed to enable bluetooth (err %d)", err);
		return;
	}

	if (IS_ENABLED(CONFIG_SETTINGS)) {
		settings_load();
	}

	err = bt_le_adv_start(BT_LE_ADV_CONN_NAME_ID, ad, ARRAY_SIZE(ad), NULL, 0);
	if (err) {
		LOG_ERR("Advertising failed to start (err %d)", err);
		return;
	}
}

void main(void)
{
	int err = 0;

	err = bt_enable(bt_ready);
	if (err) {
		LOG_ERR("Bluetooth init failed (err %d)", err);
		return;
	}
    bt_conn_cb_register(&conn_callbacks);

    err = battery_init(NULL);
    if (err != 0) {
    	LOG_ERR("Battery init failed (err %d", err);
    }

	while (1) {
		k_sleep(K_FOREVER);
	}
}
```

## src/bas.c
```c
#include <zephyr.h>
#include <errno.h>

#include <bluetooth/uuid.h>
#include <bluetooth/gatt.h>

#include "battery.h"

#define MAX_BAT_LVL 0x0350
#define MIN_BAT_LVL 0x02c5

static ssize_t read_blvl(struct bt_conn *conn, const struct bt_gatt_attr *attr,
		void *buf, u16_t len, u16_t offset);

/* Battery Service Declaration */
BT_GATT_SERVICE_DEFINE(bas_svc,
	BT_GATT_PRIMARY_SERVICE(BT_UUID_BAS),
	BT_GATT_CHARACTERISTIC(BT_UUID_BAS_BATTERY_LEVEL,
			BT_GATT_CHRC_READ, BT_GATT_PERM_READ, read_blvl, NULL, NULL),
	BT_GATT_CCC(NULL, BT_GATT_PERM_NONE)
);


static ssize_t read_blvl(struct bt_conn *conn, const struct bt_gatt_attr *attr,
		void *buf, u16_t len, u16_t offset)
{
	u16_t value = battery_read_value();
	if (value > MAX_BAT_LVL) {
		value = MAX_BAT_LVL;
	} else if (value < MIN_BAT_LVL) {
		value = MIN_BAT_LVL;
	}

	value  = (value - MIN_BAT_LVL) * 100;
	value /= (MAX_BAT_LVL - MIN_BAT_LVL);

	u8_t battery_value = (u8_t) value;

	return bt_gatt_attr_read(conn, attr, buf, len, offset, &battery_value,
			sizeof(battery_value));
}
```

## src/battery.c
```c
#include "battery.h"

#include "config.h"
#include <device.h>
#include <gpio.h>

#include <adc.h>
#include <hal/nrf_adc.h>

struct device *battery_en;

static int16_t m_sample_buffer;

struct device *adc_dev;

static const struct adc_channel_cfg adc_cfg = {
    .gain             = ADC_GAIN,
    .reference        = ADC_REFERENCE,
    .acquisition_time = ADC_ACQ_TIME_DEFAULT,
    .input_positive   = BATTERY_SENSE_PIN,
};

struct adc_sequence adc_sequence = {
    .buffer      = &m_sample_buffer,
    .buffer_size = sizeof(m_sample_buffer),
    .resolution  = ADC_RESOLUTION,
};

s8_t battery_init(struct device *a_dev) {
    battery_en = device_get_binding(GPIO_PORT);

    gpio_pin_configure(battery_en, BATTERY_EN_PIN, GPIO_DIR_OUT);
    gpio_pin_write(battery_en, BATTERY_EN_PIN, 0);
    
    if(a_dev == 0)
        adc_dev = device_get_binding(ADC_DEVICE_NAME);
    else
        adc_dev = a_dev;

    if(adc_dev == 0)
        return -ENODEV;

    return adc_channel_setup(adc_dev, &adc_cfg);
}

u16_t battery_read_value() {
    int value = 0;

    if(adc_channel_setup(adc_dev, &adc_cfg) != 0)
        return -1;
    adc_sequence.channels = BIT(adc_cfg.channel_id);

    gpio_pin_write(battery_en, BATTERY_EN_PIN, 1);
    value = adc_read(adc_dev, &adc_sequence);
    gpio_pin_write(battery_en, BATTERY_EN_PIN, 0);

    if(value < 0)
        return -1;

    return m_sample_buffer;
}
```

## src/battery.h
```c
#include <device.h>
#include <zephyr/types.h>

s8_t battery_init(struct device *);
u16_t battery_read_value(void);
```

## src/config.h
```c
#ifdef	DT_ALIAS_GPIO_0_LABEL
#define GPIO_PORT		DT_ALIAS_GPIO_0_LABEL
#define BATTERY_EN_PIN	17	// P0.17
#else
#error "Choose supported GPIO 0 driver"
#endif

#ifdef DT_ADC_0_NAME
#define ADC_DEVICE_NAME         DT_ADC_0_NAME
#define ADC_RESOLUTION          10
#define ADC_GAIN                ADC_GAIN_1_3
#define ADC_REFERENCE           ADC_REF_INTERNAL
#define ADC_ACQUISITION_TIME    ADC_ACQ_TIME_DEFAULT
#define BATTERY_SENSE_PIN       NRF_ADC_CONFIG_INPUT_4  // P0.03/GPIO3/ANALOG4
#else
#error "you need to define ADC 0"
#endif

/*
#ifdef CONFIG_SOC_NRF52840_QIAA
#ifdef DT_ALIAS_ADC_0_LABEL
#include <hal/nrf_saadc.h>
#define ADC_DRIVER DT_ALIAS_ADC_0_LABEL
#define BATTERY_SENSE_PIN NRF_SAADC_INPUT_AIN2  // P0.04/AIN2
#else
#error "you need to define ADC 0"
#endif
#endif
*/
```

## src/ess.c
```c
#include <zephyr.h>
#include <stddef.h>

#include <bluetooth/uuid.h>
#include <bluetooth/gatt.h>

#include <drivers/sensor.h>

#include <logging/log.h>

LOG_MODULE_REGISTER(ess);

static ssize_t read_temp_ambient(struct bt_conn *conn, const struct bt_gatt_attr *attr,
        void *buf, u16_t len, u16_t offset);
static ssize_t read_temp_die(struct bt_conn *conn, const struct bt_gatt_attr *attr,
			 void *buf, u16_t len, u16_t offset);

/* ESS Declaration */
BT_GATT_SERVICE_DEFINE(ess_svc,
	BT_GATT_PRIMARY_SERVICE(BT_UUID_ESS),
	BT_GATT_CHARACTERISTIC(BT_UUID_TEMPERATURE,
			       BT_GATT_CHRC_READ, BT_GATT_PERM_READ, read_temp_ambient, NULL, NULL),
	BT_GATT_CCC(NULL, BT_GATT_PERM_NONE),
	BT_GATT_CHARACTERISTIC(BT_UUID_TEMPERATURE,
			       BT_GATT_CHRC_READ, BT_GATT_PERM_READ, read_temp_die, NULL, NULL),
	BT_GATT_CCC(NULL, BT_GATT_PERM_NONE),
);

static ssize_t read_temp_ambient(struct bt_conn *conn, const struct bt_gatt_attr *attr,
        void *buf, u16_t len, u16_t offset)
{
	struct device *dev;
	struct sensor_value ambient_temp;

	dev = device_get_binding(DT_INST_0_MAXIM_MAX31855_LABEL);
	if (dev == NULL) {
		LOG_ERR("Cannot get device %s", DT_INST_0_MAXIM_MAX31855_LABEL);
		return -ENODEV;
	}

	sensor_sample_fetch(dev);
	sensor_channel_get(dev, SENSOR_CHAN_AMBIENT_TEMP, &ambient_temp);

	s16_t temperature = ambient_temp.val1 * 100
			+ ambient_temp.val2 / 10000;

    return bt_gatt_attr_read(conn, attr, buf, len, offset, &temperature,
            sizeof(temperature));
}

static ssize_t read_temp_die(struct bt_conn *conn, const struct bt_gatt_attr *attr,
			 void *buf, u16_t len, u16_t offset)
{
	struct device *dev;
	struct sensor_value die_temp;

	dev = device_get_binding(DT_INST_0_MAXIM_MAX31855_LABEL);
	if (dev == NULL) {
		LOG_ERR("Cannot get device %s", DT_INST_0_MAXIM_MAX31855_LABEL);
		return -ENODEV;
	}

	sensor_sample_fetch(dev);
	sensor_channel_get(dev, SENSOR_CHAN_DIE_TEMP, &die_temp);

	s16_t temperature = die_temp.val1 * 100
				+ die_temp.val2 / 10000;

	return bt_gatt_attr_read(conn, attr, buf, len, offset, &temperature,
	            sizeof(temperature));
}
```

## src/uuid.h
```c
#include <bluetooth/uuid.h>

/**
 * UUID (v1):  77e1XXXX-37af-11ea-a7a1-507b9de20712
 */

#define BT_UUID_BASE	BT_UUID_DECLARE_128(BT_UUID_128_ENCODE(0x77e10000, 0x37af, 0x11ea, 0xa7a1, 0x507b9de20712))

/** @def BT_UUID_COS
 *  @brief Cooker Service
 */
#define BT_UUID_COS						BT_UUID_DECLARE_128(BT_UUID_128_ENCODE(0x77e11801, 0x37af, 0x11ea, 0xa7a1, 0x507b9de20712))

/** @def BT_UUID_COS_OUTPUT_POWER
 *  @brief COS Characteristic Output Power State
 */
#define BT_UUID_COS_TEMPERATURE			BT_UUID_DECLARE_128(BT_UUID_128_ENCODE(0x77e12a05, 0x37af, 0x11ea, 0xa7a1, 0x507b9de20712))
```
